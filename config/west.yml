## config/west.yml
```yaml
manifest:
  remotes:
    - name: zmkfirmware
      url-base: https://github.com/zmkfirmware
    - name: petejohanson
      url-base: https://github.com/petejohanson
  projects:
    - name: zmk
      remote: petejohanson
      revision: ble/hog-characteristic-perm-tweaks-macos
        #revision: ble/defer-connection-param-upgarade-while-pairing
      import: app/west.yml
  self:
    path: config
```
